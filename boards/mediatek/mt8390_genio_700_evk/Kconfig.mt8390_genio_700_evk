## boards/mediatek/mt8390_genio_700_evk/Kconfig.mt8390_genio_700_evk
```kconfig
# Copyright 2025 MediaTek
# SPDX-License-Identifier: Apache-2.0

config BOARD_MT8390_GENIO_700_EVK
	select SOC_MT8188_A55 if BOARD_MT8390_GENIO_700_EVK_MT8188_A55
```

## drivers/audio/Kconfig.mt8188_afe
```kconfig
# Copyright (c) 2026 MediaTek Inc.
# SPDX-License-Identifier: Apache-2.0

config AUDIO_MT8188_AFE
	bool "MediaTek MT8188 Audio Front End"
	default y
	depends on DT_HAS_MEDIATEK_MT8188_AFE_ENABLED
	depends on CLOCK_CONTROL_MT8188_APMIXED
	depends on CLOCK_CONTROL_MT8188_TOPCKGEN
	depends on CLOCK_CONTROL_MT8188_INFRA_AO
	select PINCTRL
	help
	  Enable the Audio Front End, which moves samples between memory and
	  the die's eTDM serial ports.

	  The interface callers use is in
	  <zephyr/drivers/audio/mt8188_afe.h>.  It is not the Zephyr DAI
	  interface: the routing matrix, the channel-merge units and the
	  cowork'd port pairs have no expression in DAI.

	  The three clock controllers are required rather than selected because
	  the AFE reaches them through the clocks its devicetree node names, so
	  a configuration without them would not describe working hardware.
```

## drivers/clock_control/Kconfig.mtk
```kconfig
# Copyright (c) 2026 MediaTek Inc.
# SPDX-License-Identifier: Apache-2.0

config CLOCK_CONTROL_MT8188_INFRA_AO
	bool "MediaTek MT8188 infra always-on clock controller"
	default y
	depends on DT_HAS_MEDIATEK_MT8188_INFRACFG_AO_ENABLED
	help
	  Enable the peripheral gate clocks in the MT8188 infra always-on
	  subsystem.

config CLOCK_CONTROL_MT8188_APMIXED
	bool "MediaTek MT8188 APMIXEDSYS PLL clock controller"
	default y
	depends on DT_HAS_MEDIATEK_MT8188_APMIXEDSYS_ENABLED
	help
	  Enable the phase-locked loops in the MT8188 APMIXEDSYS block,
	  including the APLL1 and APLL2 audio pair.

config CLOCK_CONTROL_MT8188_TOPCKGEN
	bool "MediaTek MT8188 TOPCKGEN clock controller"
	default y
	depends on DT_HAS_MEDIATEK_MT8188_TOPCKGEN_ENABLED
	help
	  Enable the top-level muxes, dividers and gates that distribute the
	  MT8188 PLL outputs, including the audio timing domains and the
	  per-port audio master clocks.
```

## drivers/hwinfo/Kconfig.mtk
```kconfig
# Copyright (c) 2026 MediaTek Inc.
# SPDX-License-Identifier: Apache-2.0

config HWINFO_MT8188
	bool "MediaTek MT8188 reset cause"
	default y
	depends on DT_HAS_MEDIATEK_MT8188_WDT_ENABLED
	select HWINFO_HAS_DRIVER
	help
	  Report the cause of the last reset, as the top reset generation unit
	  records it: a watchdog expiry or a software reset.

	  The cause is read from the unit's status register at boot.  The
	  driver depends on the watchdog node being enabled, since it reads
	  the same register block.
```

## drivers/pinctrl/Kconfig.mtk
```kconfig
# Copyright 2025 MediaTek
# SPDX-License-Identifier: Apache-2.0

config PINCTRL_MT8188
	bool "MediaTek MT8188 pin controller"
	default y
	depends on DT_HAS_MEDIATEK_MT8188_PINCTRL_ENABLED
	help
	  Enable the pin controller driver for MediaTek MT8188.
```

## drivers/watchdog/Kconfig.mtk
```kconfig
# Copyright (c) 2026 MediaTek Inc.
# SPDX-License-Identifier: Apache-2.0

config WDT_MT8188
	bool "MediaTek MT8188 watchdog driver"
	default y
	depends on DT_HAS_MEDIATEK_MT8188_WDT_ENABLED
	select HAS_WDT_DISABLE_AT_BOOT
	select HAS_WDT_NO_CALLBACKS
	help
	  Enable the driver for the watchdog of the MediaTek MT8188 top reset
	  generation unit (TOPRGU).

	  It offers one timeout of 2 to 31 seconds, and an expiry resets the
	  SoC.  The unit raises no interrupt before the reset, so a timeout
	  cannot have a callback.
```

## dts/bindings/audio/mediatek,mt8188-afe.yaml
```yaml
# Copyright (c) 2026 MediaTek Inc.
# SPDX-License-Identifier: Apache-2.0

description: |
  MediaTek MT8188 Audio Front End.

  Moves samples between memory and the die's eTDM serial ports.  The interface
  callers use is in <zephyr/drivers/audio/mt8188_afe.h>.

  Note that the audio DSP on this die carries a separate "mediatek,afe" binding
  used by SOF, describing the same hardware from the DSP's side.  The two are
  independent.

compatible: "mediatek,mt8188-afe"

include: [base.yaml, pinctrl-device.yaml]

properties:
  reg:
    required: true

  interrupts:
    required: true

  pinctrl-0:
    description: |
      The eTDM pins this board brings out, which the driver selects at init.
      Optional, because the pins a board wires to the ports are a board matter
      and one that has already muxed them elsewhere need not repeat it here.

  clocks:
    required: true

  clock-names:
    required: true
    description: |
      The clocks the AFE consumes.  Three of the names also identify the
      controllers the driver talks to directly, so they have to be present:
      "apll1" names the PLL controller, "top_a1sys_hp" the top-level clock
      controller, and "infra_audio" the always-on infrastructure controller.

  memory-region:
    type: phandle
    description: |
      Region the AFE reads playback samples from and writes captured samples
      to.  The AFE does not share the processor's caches, so the driver maps
      this region non-cacheable; placing buffers anywhere else leaves capture
      reading stale data and playback sending lines the AFE never sees.

      A region outside the image also keeps a misprogrammed transfer away from
      the running program.  Omit it and the driver maps nothing, which suits a
      board that has no audio buffers to place.
```

## dts/bindings/clock/mediatek,mt8188-apmixedsys.yaml
```yaml
# Copyright (c) 2026 MediaTek Inc.
# SPDX-License-Identifier: Apache-2.0

description: |
  MediaTek MT8188 APMIXEDSYS PLL clock controller.

  Provides the die's phase-locked loops, of which APLL1 and APLL2 are the audio
  pair: APLL1 serves the 48 kHz sample-rate family and APLL2 the 44.1 kHz one.
  A consumer selects a PLL with the matching CLK_APMIXED_* identifier from
  <zephyr/dt-bindings/clock/mtk_mt8188_clock.h>, for example:

    &afe {
            clocks = <&apmixedsys CLK_APMIXED_APLL1>;
    };

compatible: "mediatek,mt8188-apmixedsys"

include: [clock-controller.yaml, base.yaml]

properties:
  reg:
    required: true

  "#clock-cells":
    const: 1

clock-cells:
  - name
```

## dts/bindings/clock/mediatek,mt8188-topckgen.yaml
```yaml
# Copyright (c) 2026 MediaTek Inc.
# SPDX-License-Identifier: Apache-2.0

description: |
  MediaTek MT8188 TOPCKGEN clock controller.

  Provides the top-level muxes, dividers and gates that distribute the PLL
  outputs to the rest of the die.  A consumer selects a clock with the matching
  CLK_TOP_* identifier from <zephyr/dt-bindings/clock/mtk_mt8188_clock.h>, for
  example:

    &afe {
            clocks = <&topckgen CLK_TOP_A1SYS_HP>;
    };

  Clocks whose parent depends on the stream, such as the per-port audio master
  clock muxes, take their parent through the clock_control_configure() call
  rather than from a fixed value here, so that enabling a gate does not
  disturb a parent selected at runtime.

compatible: "mediatek,mt8188-topckgen"

include: [clock-controller.yaml, base.yaml]

properties:
  reg:
    required: true

  "#clock-cells":
    const: 1

clock-cells:
  - name
```

## dts/bindings/interrupt-controller/mediatek,mt8188-eint.yaml
```yaml
# Copyright 2025 MediaTek
# SPDX-License-Identifier: Apache-2.0

description: |
  MediaTek MT8188 external interrupt controller.

  Multiplexes the per-pin external interrupt lines onto a single parent
  interrupt.  GPIO banks reference this controller to register for events on
  their pins.

compatible: "mediatek,mt8188-eint"

include: [base.yaml]

properties:
  reg:
    required: true

  interrupts:
    required: true

  num-lines:
    type: int
    required: true
    description: Number of external interrupt lines implemented.
```

## dts/bindings/watchdog/mediatek,mt8188-wdt.yaml
```yaml
# Copyright (c) 2026 MediaTek Inc.
# SPDX-License-Identifier: Apache-2.0

description: |
  MediaTek MT8188 watchdog, the timer of the top reset generation unit
  (TOPRGU).

  One timeout of 2 to 31 seconds in steps of 1/64 second.  On expiry the unit
  resets the SoC.  It has no interrupt in this description, so a timeout
  cannot call back before the reset.

  The same block holds the subsystem reset lines (SWSYSRST), which other
  drivers pulse; this binding describes only the watchdog.

compatible: "mediatek,mt8188-wdt"

include: base.yaml

properties:
  reg:
    required: true

  mediatek,disable-extrst:
    type: boolean
    description: |
      Clear the external reset output when the watchdog is started, so that
      an expiry does not drive the reset pin.  Without this property the
      driver leaves the setting the firmware made.
```

## soc/mediatek/mt8xxx/Kconfig
```kconfig
# Copyright 2024 The ChromiumOS Authors
# SPDX-License-Identifier: Apache-2.0

config SOC_FAMILY_MT8XXX
	select XTENSA
```

## tests/drivers/watchdog/wdt_error_cases/testcase.yaml
```yaml
common:
  tags:
    - drivers
    - watchdog
  depends_on: watchdog
  harness: ztest

tests:
  drivers.watchdog.wdt_error_cases:
    platform_allow:
      - nrf5340dk/nrf5340/cpuapp
      - nrf5340dk/nrf5340/cpunet
      - nrf54h20dk/nrf54h20/cpuapp
      - nrf54h20dk/nrf54h20/cpurad
      - nrf54l15dk/nrf54l15/cpuapp
      - nrf54lm20dk/nrf54lm20a/cpuapp
      - nrf54lm20dk/nrf54lm20b/cpuapp
      - nrf7120dk/nrf7120/cpuapp
      - nrf9280pdk/nrf9280/cpuapp
      - nrf9280pdk/nrf9280/cpurad
      - ophelia4ev/nrf54l15/cpuapp
      - xg24_rb4187c
      - xg27_dk2602a
      - raytac_an54lq_db_15/nrf54l15/cpuapp
      - sam_e54_xpro
      - pic32cx_sg41_cult
      - mt8370_genio_510_evk/mt8188/a55
      - mt8390_genio_700_evk/mt8188/a55
    integration_platforms:
      - nrf54l15dk/nrf54l15/cpuapp
      - ophelia4ev/nrf54l15/cpuapp
      - raytac_an54lq_db_15/nrf54l15/cpuapp
  drivers.watchdog.wdt_error_cases_pm:
    platform_allow:
      - xg24_rb4187c
      - xg27_dk2602a
    extra_configs:
      - CONFIG_PM=y
```
